// SPDX-License-Identifier: (GPL-2.0+ OR BSD-3-Clause)
/* Enable SPI4 on the M5-Bus with a userspace spidev on CS0 (/dev/spidev*) */
/dts-v1/;
/plugin/;

#include <dt-bindings/gpio/gpio.h>

&spi4 {
	#address-cells = <1>;
	#size-cells = <0>;
	cs-gpios = <&gpiob 13 GPIO_ACTIVE_LOW>;
	status = "okay";

	spidev@0 {
		compatible = "rohm,dh2228fv";	/* any spidev-listed compatible */
		reg = <0>;
		spi-max-frequency = <20000000>;
	};
};
